// SPDX-License-Identifier: GPL-2.0

#include "simple_smp.dtsi"

/ {
	model = "Terasic DE0 Nano";
};

&cpu0 {
	clock-frequency = <50000000>;
};

&cpu1 {
	clock-frequency = <50000000>;
};

&serial0 {
	clock-frequency = <50000000>;
};
